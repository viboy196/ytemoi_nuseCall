## main/Kconfig.projbuild
```kconfig
menu "VoIP App Configuration"

choice VOIP_CODEC
    prompt "SIP Codec"
    default SIP_CODEC_G711A
    help
        sip codec

config SIP_CODEC_G711A
    bool "G711 PCMA"
config SIP_CODEC_G711U
    bool "G711 PCMU"
endchoice

config WIFI_SSID
    string "WiFi SSID"
    default "myssid"
    help
    SSID (network name) for the example to connect to.

config WIFI_PASSWORD
    string "ytemoiinternet"
    default "12345678"
    help
    WiFi password (WPA or WPA2) for the example to use.

config SIP_URI
    string "SIP URI"
    default "udp://203:203@192.168.137.1:5060"
    help
    The SIP URI with username, password, address, port and transport type

endmenu
```
